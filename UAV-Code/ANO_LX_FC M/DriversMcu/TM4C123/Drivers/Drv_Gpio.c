#include "Drv_Gpio.h"
#include "hw_types.h"
#include "hw_gpio.h"

void DrvGpioSenserCsPinInit(void)
{
	//PC2\3����
	ROM_SysCtlPeripheralEnable(SYSCTL_PERIPH_GPIOC);
    HWREG(GPIOC_BASE + GPIO_O_LOCK) = GPIO_LOCK_KEY;
    HWREG(GPIOC_BASE + GPIO_O_CR) |= 0xFC;
    HWREG(GPIOC_BASE + GPIO_O_LOCK) = 0;
	//AK8975
	ROM_SysCtlPeripheralEnable(AK_CSPIN_SYSCTL);
	ROM_GPIOPinTypeGPIOOutput(AK8975_CS_PORT,AK8975_CS_PIN);
	ROM_GPIOPinWrite(AK8975_CS_PORT, AK8975_CS_PIN,AK8975_CS_PIN);
	//SPL06
	ROM_SysCtlPeripheralEnable(SPL_CSPIN_SYSCTL);
	ROM_GPIOPinTypeGPIOOutput(SPL06_CS_PORT,SPL06_CS_PIN);
	ROM_GPIOPinWrite(SPL06_CS_PORT, SPL06_CS_PIN,SPL06_CS_PIN);
	//BMI088
	ROM_SysCtlPeripheralEnable(BMI088ACC_CSPIN_SYSCTL);
	ROM_GPIOPinTypeGPIOOutput(BMI088ACC_CS_PORT,BMI088ACC_CS_PIN);
	ROM_GPIOPinWrite(BMI088ACC_CS_PORT, BMI088ACC_CS_PIN,BMI088ACC_CS_PIN);
	
	ROM_SysCtlPeripheralEnable(BMI088GYR_CSPIN_SYSCTL);
	ROM_GPIOPinTypeGPIOOutput(BMI088GYR_CS_PORT,BMI088GYR_CS_PIN);
	ROM_GPIOPinWrite(BMI088GYR_CS_PORT, BMI088GYR_CS_PIN,BMI088GYR_CS_PIN);
}

void DrvGpioCsPinCtrlAk8975(u8 ena)
{
	if(ena)
		ROM_GPIOPinWrite(AK8975_CS_PORT, AK8975_CS_PIN,0);
	else
		ROM_GPIOPinWrite(AK8975_CS_PORT, AK8975_CS_PIN,AK8975_CS_PIN);
}

void DrvGpioCsPinCtrlSpl06(u8 ena)
{
	if(ena)
		ROM_GPIOPinWrite(SPL06_CS_PORT, SPL06_CS_PIN,0);
	else
		ROM_GPIOPinWrite(SPL06_CS_PORT, SPL06_CS_PIN,SPL06_CS_PIN);
}

void DrvGpioCsPinCtrlBmi088Acc(u8 ena)
{
	if(ena)
		ROM_GPIOPinWrite(BMI088ACC_CS_PORT, BMI088ACC_CS_PIN,0);
	else
		ROM_GPIOPinWrite(BMI088ACC_CS_PORT, BMI088ACC_CS_PIN,BMI088ACC_CS_PIN);
}
void DrvGpioCsPinCtrlBmi088Gyr(u8 ena)
{
	if(ena)
		ROM_GPIOPinWrite(BMI088GYR_CS_PORT, BMI088GYR_CS_PIN,0);
	else
		ROM_GPIOPinWrite(BMI088GYR_CS_PORT, BMI088GYR_CS_PIN,BMI088GYR_CS_PIN);
}

